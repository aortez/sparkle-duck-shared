## yocto/meta-pi-base/conf/layer.conf
```bitbake
# Layer configuration for meta-pi-base.
# Shared Yocto layer for Raspberry Pi projects in the Sparkle Duck family.

# We have a conf and classes directory, add to BBPATH.
BBPATH .= ":${LAYERDIR}"

# We have recipes-* directories, add to BBFILES.
BBFILES += "${LAYERDIR}/recipes-*/*/*.bb \
            ${LAYERDIR}/recipes-*/*/*.bbappend"

BBFILE_COLLECTIONS += "pi-base"
BBFILE_PATTERN_pi-base = "^${LAYERDIR}/"
BBFILE_PRIORITY_pi-base = "8"

# Layer dependencies.
LAYERDEPENDS_pi-base = "core"
LAYERSERIES_COMPAT_pi-base = "scarthgap styhead"

# Export layer directory for downstream layers to reference.
LAYERDIR_pi-base = "${LAYERDIR}"

# Default WKS partition sizes (in MB). Override in your image recipe.
BOOT_SIZE ?= "150"
ROOTFS_SIZE ?= "800"
DATA_SIZE ?= "100"
```
